## config/west.yml
```yaml
manifest:
  remotes:
    - name: zmkfirmware
      url-base: https://github.com/zmkfirmware
    - name: katafoxi
      url-base: https://github.com/katafoxi
  projects:
    - name: zmk
      remote: zmkfirmware
      revision: main
      import: app/west.yml
    - name: skeletyl-zmk-config
      remote: katafoxi
      revision: main
  self:
    path: config
```
